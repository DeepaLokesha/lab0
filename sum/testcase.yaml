## sum/testcase.yaml
```yaml
tests:
  sample.sum:
    tags: sample
    platform_allow: nrf7002dk/nrf5340/cpuapp/ns
```

## sum/tests/SUM_UNIT_TEST/Kconfig
```kconfig
# Kconfig for sum unit testing
mainmenu "SUM Unit Test Configuration"

source "Kconfig.zephyr"
```

## sum/tests/SUM_UNIT_TEST/testcase.yaml
```yaml
tests:
  sum_log.test:
    # platform_allow: qemu_cortex_m3
    tags: sum_log unit
    harness: ztest
```

## sum/tests/SUM_UNIT_TEST/twister-clean/qemu_cortex_m3_ti_lm3s6965/zephyr_gnu/Users/Dell/Downloads/ESE5180/Lab0/lab0-zephyr-skeleton/sum/tests/SUM_UNIT_TEST/sum_log.test/Kconfig/boards/Kconfig.defconfig
```kconfig
# Load Zephyr board defconfig descriptions.
osource "C:/ncs/v3.4.0/zephyr/boards/qemu/cortex_m3/Kconfig.defconfig"
```

## sum/tests/SUM_UNIT_TEST/twister-clean/qemu_cortex_m3_ti_lm3s6965/zephyr_gnu/Users/Dell/Downloads/ESE5180/Lab0/lab0-zephyr-skeleton/sum/tests/SUM_UNIT_TEST/sum_log.test/Kconfig/boards/Kconfig.sysbuild.tmp
```kconfig
# Load Sysbuild board Kconfig descriptions.
osource "C:/ncs/v3.4.0/zephyr/boards/qemu/cortex_m3/Kconfig.sysbuild"
```
