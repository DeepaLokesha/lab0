## CMakeLists.txt
```
cmake_minimum_required(VERSION 3.20.0)
find_package(Zephyr REQUIRED HINTS $ENV{ZEPHYR_BASE})
project(sum)

target_sources(app PRIVATE src/main.c)
target_include_directories(app PRIVATE ${CMAKE_CURRENT_SOURCE_DIR})

if(CONFIG_SUM_PRINT)
	target_sources(app PRIVATE sum_printk/sum_printk.c)
elseif(CONFIG_SUM_LOG)
	target_sources(app PRIVATE sum_log/sum_log.c)
endif()
```

## Kconfig
```
choice SUM_IMPL
	prompt "Sum function implementation"
	default SUM_PRINT

config SUM_PRINT
	bool "Use printk() implementation"

config SUM_LOG
	bool "Use Logger (LOG_*) implementation"

endchoice

source "Kconfig.zephyr"
```

## prj.conf
```kconfig
# Console / UART so printk() output is visible
CONFIG_CONSOLE=y
CONFIG_UART_CONSOLE=y

# Logger subsystem, used by the sum_log implementation
CONFIG_LOG=y
CONFIG_LOG_DEFAULT_LEVEL=3
```

## src/main.c
```c
/*
 * Section 6: sum function implemented via printk() or the Logger,
 * selected at build time via Kconfig (CONFIG_SUM_PRINT / CONFIG_SUM_LOG).
 */

#include <zephyr/kernel.h>

#if defined(CONFIG_SUM_PRINT)
#include "sum_printk/sum_printk.h"
#elif defined(CONFIG_SUM_LOG)
#include "sum_log/sum_log.h"
#endif

int main(void)
{
	int a = 5;
	int b = 7;
	int result;

#if defined(CONFIG_SUM_PRINT)
	result = sum_printk(a, b);
#elif defined(CONFIG_SUM_LOG)
	result = sum_log(a, b);
#else
#error "Either CONFIG_SUM_PRINT or CONFIG_SUM_LOG must be enabled"
#endif

	printk("main: sum() returned %d\n", result);

	return 0;
}
```
